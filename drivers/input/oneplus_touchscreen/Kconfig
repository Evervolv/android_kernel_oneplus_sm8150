## drivers/input/oneplus_touchscreen/Kconfig
```kconfig
#
# Touchscreen driver configuration
#
config TOUCHPANEL_ONEPLUS
	bool "OnePlus Touchpanel"
	depends on I2C
	help
	  Say Y here if you have a OnePlus Touchpanel.

config TOUCHPANEL_SAMSUNG
	bool "Samsung Touchpanel Driver"
	depends on TOUCHPANEL_ONEPLUS
	help
	  Say Y here if you have a Samsung Touchpanel.

	  If unsure, say N.

source "drivers/input/oneplus_touchscreen/samsung/Kconfig"

config TOUCHPANEL_SYNAPTICS
	bool "Synaptics Touchpanel Driver"
	depends on TOUCHPANEL_ONEPLUS
	help
	  Say Y here if you have a Synaptics Touchpanel.

	  If unsure, say N.

source "drivers/input/oneplus_touchscreen/synaptics/Kconfig"
```

## drivers/input/touchscreen/samsung/Kconfig
```kconfig
config TOUCHPANEL_SAMSUNG_S6SY761
	bool "Samsung s6sy761 Touchpanel Driver"
        depends on TOUCHPANEL_SAMSUNG
        help
          Say Y here if you have a Samsung s6sy761 Touchpanel.

          If unsure, say N.
```

## drivers/input/touchscreen/synaptics/Kconfig
```kconfig
config TOUCHPANEL_SYNAPTICS_S3706
        bool "Synaptics s3706 Touchscreen Driver"
        depends on I2C
        help
          Say Y here if you have a Synaptics s3706 Touchpanel.

          If unsure, say N.
```

## techpack/data/Kconfig
```kconfig
menu "Qualcomm RmNet Extensions"

source "techpack/data/drivers/Kconfig"

endmenu
```

## techpack/data/drivers/Kconfig
```kconfig
menu "Qualcomm RmNet Extensions"

source "techpack/data/drivers/rmnet/Kconfig"

endmenu
```

## techpack/data/drivers/rmnet/Kconfig
```kconfig
source "techpack/data/rmnet/perf/Kconfig"

source "techpack/data/drivers/rmnet/shs/Kconfig"
```
